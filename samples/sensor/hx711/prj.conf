## prj.conf
```kconfig
CONFIG_SENSOR=y
CONFIG_HX711=y
CONFIG_GPIO=y
CONFIG_LOG=y
CONFIG_REBOOT=y
CONFIG_PM=y
CONFIG_PM_DEVICE=y
CONFIG_PM_DEVICE_RUNTIME=y
```

## boards/nrf52dk_nrf52832.overlay
```dts
/*
 * Copyright (c) 2020 George Gkinis
 * SPDX-License-Identifier: Apache-2.0
 */

/ {
	aliases {
		hx711-sensor = &hx711;
	};

	hx711:hx711 {
			compatible = "avia,hx711";
			status = "okay";
			label = "HX711";
			offset = <1000>;
			slope = <1 2>;
			calibration-weight = <500 5>;
			sample-fetch-timeout-ms = <700>;
			gain = <1>;
			rate-hz = <1>;
			disable-interrupts-while-polling;

    		dout-gpios = <&gpio0 30 (GPIO_ACTIVE_HIGH | GPIO_PULL_UP)>;
    		sck-gpios = <&gpio0 29 GPIO_ACTIVE_HIGH>;
    		rate-gpios = <&gpio0 31 GPIO_ACTIVE_HIGH>;
		};
};
```

## src/main.c
```c
/*
 * Copyright (c) 2020 George Gkinis
 * SPDX-License-Identifier: Apache-2.0
 */

#include <zephyr/types.h>
#include <stddef.h>
#include <sys/util.h>
#include <sys/reboot.h>

#include <device.h>
#include <pm/device.h>
#include <pm/pm.h>
#include <drivers/sensor.h>
#include <drivers/sensor/hx711.h>

#include <logging/log.h>

LOG_MODULE_REGISTER(main, LOG_LEVEL_INF);

const struct device *hx711;

void set_rate(enum hx711_rate rate)
{
	static struct sensor_value rateVal;

	rateVal.val1 = rate;
	sensor_attr_set(hx711,
			SENSOR_CHAN_WEIGHT,
			SENSOR_ATTR_SAMPLING_FREQUENCY,
			&rateVal);
}

void measure(void)
{
	static struct sensor_value weight;
	int ret;

	ret = sensor_sample_fetch(hx711);
	if (ret != 0) {
		LOG_ERR("Cannot take measurement: %d  ", ret);
	} else {
		sensor_channel_get(hx711, SENSOR_CHAN_WEIGHT, &weight);
		LOG_INF("weight: %d.%06d", weight.val1, weight.val2);
	}
}

void main(void)
{
	hx711 = DEVICE_DT_GET(DT_ALIAS(hx711_sensor));

	__ASSERT(hx711 == NULL, "Failed to get device binding");

	LOG_INF("============= start =============");
	LOG_INF("device is %p, name is %s", hx711, hx711->name);

	LOG_INF("Calculating offset...");
	avia_hx711_tare(hx711, 5);

	struct sensor_value calibration_weight;

	sensor_attr_get(hx711,
			SENSOR_CHAN_WEIGHT,
			SENSOR_ATTR_CALIBRATION,
			&calibration_weight);

	LOG_INF("waiting for known weight of %d.%06d grams...",
		calibration_weight.val1,
		calibration_weight.val2);

	for (int i = 5; i >= 0; i--) {
		LOG_INF(" %d..", i);
		k_msleep(1000);
	}

	LOG_INF("Calculating slope...");
	avia_hx711_calibrate(hx711, 5);

	while (true) {
		k_msleep(1000);
		LOG_INF("== Test measure ==");
		LOG_INF("= Setting sampling rate to 10Hz.");
		set_rate(HX711_RATE_10HZ);
		measure();

		k_msleep(1000);
		LOG_INF("= Setting sampling rate to 80Hz.");
		set_rate(HX711_RATE_80HZ);
		measure();

		LOG_INF("====== Reboot in 5sec. =========");
		k_msleep(5000);
		sys_reboot(SYS_REBOOT_COLD);
	}
}
```
